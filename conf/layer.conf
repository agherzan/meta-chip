## conf/layer.conf
```bitbake
# We have a conf and classes directory, add to BBPATH
BBPATH .= ":${LAYERDIR}"

# We have a recipes-* directories, add to BBFILES
BBFILES += "${LAYERDIR}/recipes-*/*/*.bb \
    ${LAYERDIR}/recipes-*/*/*.bbappend"

BBFILE_COLLECTIONS += "meta-chip"
BBFILE_PATTERN_meta-chip = "^${LAYERDIR}/"
BBFILE_PRIORITY_meta-chip = "6"

# Add this to get access to sunxi-tools recipe
LAYERDEPENDS_meta-chip = "meta-sunxi"

LAYERSERIES_COMPAT_meta-chip = "pyro"
```

## conf/machine/chip.conf
```bitbake
#@TYPE: Machine
#@NAME: C.H.I.P. board
#@DESCRIPTION: Machine configuration for C.H.I.P. board

MACHINE_EXTRA_RRECOMMENDS = " kernel-modules"
MACHINE_ESSENTIAL_EXTRA_RDEPENDS = " kernel-image kernel-devicetree"

EXTRA_IMAGEDEPENDS += "u-boot sunxi-tools-native"

DEFAULTTUNE ?= "cortexa8t-neon"
include conf/machine/include/tune-cortexa8.inc

IMAGE_FSTYPES += "ubi"

SERIAL_CONSOLE = "115200 ttyS0"

PREFERRED_PROVIDER_virtual/kernel ?= "linux-chip"
PREFERRED_PROVIDER_u-boot ?= "u-boot-chip"

KERNEL_IMAGETYPE = "zImage"
KERNEL_DEVICETREE = "sun5i-r8-chip.dtb"

SPL_BINARY = "sunxi-spl.bin"
SPL_ECC_BINARY = "sunxi-spl-with-ecc.bin"
UBOOT_BINARY = "u-boot-dtb.bin"
UBOOT_MACHINE = "CHIP_defconfig"

MACHINE_FEATURES = "usbgadget usbhost wifi"

# Include wifi modules and firmware
MACHINE_EXTRA_RRECOMMENDS += "kernel-module-r8723bs rtl8723bs"

UBI_VOLNAME = "rootfs"
CHIP_UBI_PAGE_SIZE = "16384"
MKUBIFS_ARGS = "--min-io-size ${CHIP_UBI_PAGE_SIZE} --leb-size 2064384 --max-leb-cnt 2000"
UBINIZE_ARGS = "--min-io-size ${CHIP_UBI_PAGE_SIZE} --peb-size 2097152 --sub-page-size 16384"

# # Required for multi_ubi_class
# IMAGE_CLASSES += "ubi_multi_vol-chip"

# IMAGE_FSTYPES += "multiubivol"

# UBIMULTIVOL_BUILD = "rootfs boot"
# UBI_VOLNAME = "ubi"
# UBINIZE_ARGS = "-m 0x4000 -p 0x200000 -s 16384"
# export MKUBIFS_ARGS_rootfs = "-e 0x1f8000 -c 500 -m 0x4000 -x lzo"
# export ADDITIONAL_MKUBIFS_ARGS_rootfs = "-r ${IMAGE_ROOTFS} -o ${DEPLOY_DIR_IMAGE}/${IMAGE_NAME}.rootfs.ubifs"
# export ADDITIONAL_UBINIZE_ARGS_rootfs = "mode=ubi\nimage=${DEPLOY_DIR_IMAGE}/${IMAGE_NAME}.rootfs.ubifs\nvol_id=0\nvol_type=dynamic\nvol_name=rootfs\nvol_flags=autoresize"

# export MKUBIFS_ARGS_boot = "-e 0x1f8000 -c 500 -m 0x4000 -x lzo"
# export ADDITIONAL_MKUBIFS_ARGS_boot = "-r ${IMAGE_ROOTFS} -o ${DEPLOY_DIR_IMAGE}/${IMAGE_NAME}.boot.ubifs"
# export ADDITIONAL_UBINIZE_ARGS_boot = "mode=ubi\nimage=${DEPLOY_DIR_IMAGE}/${IMAGE_NAME}.boot.ubifs\nvol_id=3\nvol_type=dynamic\nvol_name=boot"
```
